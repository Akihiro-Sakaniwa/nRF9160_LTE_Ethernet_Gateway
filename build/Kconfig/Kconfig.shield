## build/Kconfig/Kconfig.sysbuild.modules
```kconfig
menu "nrf (/opt/nordic/ncs/v2.5.2/nrf)"
osource "/opt/nordic/ncs/v2.5.2/nrf/sysbuild/Kconfig.sysbuild"
config ZEPHYR_NRF_MODULE
	bool
	default y
endmenu
```
